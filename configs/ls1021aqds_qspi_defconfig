## configs/ls1021aqds_qspi_defconfig
```kconfig
#R00	09/18/2015   SUN   Fixed SPI boot fail issue.

#R00 CONFIG_SYS_EXTRA_OPTIONS="QSPI_BOOT"
#R00 - Start
CONFIG_SYS_EXTRA_OPTIONS="RAMBOOT_PBL,QSPI_BOOT"
#R00 - End
+S:CONFIG_ARM=y
+S:CONFIG_TARGET_LS1021AQDS=y
CONFIG_DEFAULT_DEVICE_TREE="ls1021a-qds"
```

## configs/ls1021atwr_qspi_defconfig
```kconfig
CONFIG_SYS_EXTRA_OPTIONS="RAMBOOT_PBL,QSPI_BOOT"
+S:CONFIG_ARM=y
+S:CONFIG_TARGET_LS1021ATWR=y
CONFIG_DEFAULT_DEVICE_TREE="ls1021a-twr"
```
